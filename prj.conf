## CMakeLists.txt
```
# SPDX-License-Identifier: Apache-2.0

cmake_minimum_required(VERSION 3.20.0)
find_package(Zephyr REQUIRED HINTS $ENV{ZEPHYR_BASE})
project(blinky)


FILE(GLOB app_sources src/*.c)
target_sources(app PRIVATE ${app_sources})
```

## west.yml
```
manifest:
  remotes:
    - name: zephyrproject
      url-base: https://github.com/zephyrproject-rtos
  projects:
    - name: zephyr
      repo-path: zephyr
      remote: zephyrproject
      revision: v3.4.0
      import: true
  self:
    # This repository should be cloned to 
    path: app
```

## prj.conf
```kconfig
CONFIG_BOOT_BANNER=y

CONFIG_DEBUG_OPTIMIZATIONS=y

CONFIG_GPIO=y

CONFIG_COMMON_LIBC_MALLOC=y
CONFIG_COMMON_LIBC_MALLOC_ARENA_SIZE=16384
CONFIG_COMMON_LIBC_CALLOC=y

CONFIG_PRINTK=y
CONFIG_INIT_STACKS=y
CONFIG_THREAD_STACK_INFO=y
CONFIG_KERNEL_SHELL=y
CONFIG_THREAD_MONITOR=y
CONFIG_THREAD_NAME=y

CONFIG_SHELL=y
CONFIG_DEVICE_SHELL=y
CONFIG_POSIX_CLOCK=y
CONFIG_DATE_SHELL=y
CONFIG_THREAD_RUNTIME_STATS=y
CONFIG_THREAD_RUNTIME_STATS_USE_TIMING_FUNCTIONS=y
CONFIG_STATS=y
CONFIG_STATS_SHELL=y
CONFIG_SHELL_CMDS_SELECT=y
```

## app.overlay
```dts
// Copyright 2023 Michael Bradley

&arduino_serial {
    status = "disabled";
};
```

## src/main.c
```c
/*
 * Copyright (c) 2016 Intel Corporation
 *
 * SPDX-License-Identifier: Apache-2.0
 */

#include <stdio.h>

#include <zephyr/kernel.h>
#include <zephyr/drivers/gpio.h>
#include <zephyr/shell/shell.h>

#include "dmx512.h"

/* 1000 msec = 1 sec */
#define SLEEP_TIME_MS 500

/* The devicetree node identifier for the "led0" alias. */
#define LED0_NODE DT_ALIAS(led0)

/*
 * A build error on this line means your board is unsupported.
 * See the sample documentation for information on how to fix this.
 */
static const struct gpio_dt_spec led = GPIO_DT_SPEC_GET(LED0_NODE, gpios);

struct dmx_universe * mydmx = NULL;

void main(void)
{
	int ret;
	
	printf("Starting DMX Gadget...\n");

	if (!gpio_is_ready_dt(&led))
	{
		return;
	}

	ret = gpio_pin_configure_dt(&led, GPIO_OUTPUT_ACTIVE);
	if (ret < 0)
	{
		return;
	}

	while (1)
	{
		ret = gpio_pin_toggle_dt(&led);
		if (ret < 0)
		{
			return;
		}
		k_msleep(SLEEP_TIME_MS);
	}
}
```

## src/dmx512.c
```c
// Copyright 2023 Michael Bradley
// This file implements a DMX512 Universe data structure and functions

#include <stdint.h>
#include <stdlib.h>
#include <stdio.h>
#include <assert.h>
#include <errno.h>

#include "dmx512.h"

// Set a slot to a value, ensuring slot is valid
int32_t dmx_set_slot(struct dmx_universe * dmx_uni, uint16_t slot, uint8_t value) {
    if (!dmx_uni || slot > dmx_uni->max_slot) {
        return -EINVAL;
    };
    
    dmx_uni->slot_data[slot] = value;

    return 0;
}

// Get a slot to a value, ensuring slot is valid
int32_t dmx_get_slot(struct dmx_universe * dmx_uni, uint16_t slot, uint8_t * value) {
    if (!dmx_uni || slot > dmx_uni->max_slot) {
        return -EINVAL;
    };
    
    *value = dmx_uni->slot_data[slot];

    return 0;
}
// prints a dmx universe to the console
int32_t dmx_print(struct dmx_universe * dmx_uni) {
    uint16_t i;

    if (!dmx_uni) {
        return -EINVAL;
    }

    printf("dmx universe @0x%p\n Start Code: 0x%02X    Max Slot: %0d\n", dmx_uni, dmx_uni->start_code, dmx_uni->max_slot);

    for(i = 0; i <= dmx_uni->max_slot; i++){
        printf(" %3d", dmx_uni->slot_data[i]);
    }
    printf("\n");
    return 0;
}

// Creates a DMX512 universe
int32_t dmx_create(struct dmx_universe ** dmx_uni, uint16_t slot_count) {

    struct dmx_universe * dmx_uni_new;
    dmx_uni_new = (struct dmx_universe *) malloc(sizeof(struct dmx_universe));

    if (dmx_uni_new == NULL) {
        goto error_dmx_alloc;
    }

    // Assume always zero for now, which is used almost all the time
    dmx_uni_new->start_code = 0x00;

    // There could be a min slot in future, if we wanted to have a contiguous range of slots
    // starting a non-zero slot location
    dmx_uni_new->max_slot = slot_count - 1;

    // using dynamic memory allocation here to avoid over allocating buffers for all 512 slots
    // TODO will be dyanmic in a while
    // u32_ptr = malloc(slot_count * sizeof(uint8_t));
    // dmx_uni_new->slot_data = u32_ptr;

    // will use calloc to create zero value array but for now
    for (int i = 0; i < slot_count; i++) {
        dmx_uni_new->slot_data[i] = 0x00;
    }

//    if (dmx_uni_new->slot_data == NULL) {
//         goto error_slot_alloc;
//     }
    printf("--Created DMX Universe\n");
    dmx_print(dmx_uni_new);

   *dmx_uni = dmx_uni_new;

   return 0;

// error_slot_alloc:
//     free(dmx_uni_new);

error_dmx_alloc:
    printf("Error creating dmx universe\n");
    return -ENOMEM;
}

// Destroy a DMX512 universe
int32_t dmx_destroy(struct dmx_universe ** dmx_uni) {

    (*dmx_uni)->start_code = 0xFF;
    (*dmx_uni)->max_slot = 0;
    //free(dmx_uni->slot_data);
    // TODO dmx_uni->slot_data = NULL;
    free(*dmx_uni);
    *dmx_uni = NULL;

    return 0;
}
```

## src/dmx512.h
```c
// Copyright 2023 Michael Bradley
// This header defines the DMX512 Universe public API

#include <stdint.h>

// A DMX512 universe consists of 
// A start code/slot 0 that defines the type of data/package being sent
// 0 or more byte values for the up to 512 slots of data, typically lighting channels.
//   Note: the DMX512 standard at the protocol level requires a minimum packet length
//   (typically 24 slots) but that is not enforced in this data structure.
// struct is considered private, so no members defined here

//struct dmx_universe;
// TODO remove this later
struct dmx_universe {
    uint8_t start_code;
    uint16_t max_slot;
    uint8_t slot_data[100];  // TODO make dynamic allocation
};

// Set a slot to a value, ensuring slot is valid
int32_t dmx_set_slot(struct dmx_universe * dmx_uni, uint16_t slot, uint8_t value);

// Get a slot to a value, ensuring slot is valid
int32_t dmx_get_slot(struct dmx_universe * dmx_uni, uint16_t slot, uint8_t *value);

// prints a dmx universe to the console
int32_t dmx_print(struct dmx_universe * dmx_uni);

// Creates a DMX512 universe
int32_t dmx_create(struct dmx_universe ** dmx_uni, uint16_t slot_count);

// Destroy a DMX512 universe
int32_t dmx_destroy(struct dmx_universe ** dmx_uni);
```

## src/dmx512_shell.c
```c
// Copyright 2023 Michael Bradley
// This file implements a DMX512 Universe zephyr shell

#include <stdint.h>

#include <zephyr/shell/shell.h>

#include "dmx512.h"

extern struct dmx_universe * mydmx;

static int cmd_dmx_init(const struct shell *sh, size_t argc, char **argv)
{
	ARG_UNUSED(argc);
	ARG_UNUSED(argv);

	// shell_print(sh, "Printing DMX512 Universe");
	return dmx_create(&mydmx, 24);
}

static int cmd_dmx_print(const struct shell *sh, size_t argc, char **argv)
{
	ARG_UNUSED(argc);
	ARG_UNUSED(argv);

	int32_t ret;

	ret = dmx_print(mydmx);
	
	if (ret) {
		shell_print(sh, "Error %d", ret);
	}

	return ret;
}

static int cmd_dmx_slot(const struct shell *sh, size_t argc, char **argv)
{
    int32_t ret = 0;
    uint32_t slot_value_read;
    uint8_t slot_value;
    uint16_t slot;

    switch(argc) {
        case 3:
            slot_value_read = atoi(argv[2]);
            if (slot_value_read > 255) {
                ret = -EINVAL;
                shell_print(sh, "Error %d", ret);
                return (ret);
            }
            slot_value = (uint8_t)slot_value_read;
            // fall through is required here
        case 2:
            slot = atoi(argv[1]);
            break;

        default:
            shell_print(sh, " Expected syntax:\n  slot <slot number>  [write value]");
            return (-EINVAL);
    }

    if (argc == 2) {
        // Read and display the slot value
        ret = dmx_get_slot(mydmx, slot, &slot_value);
        if (!ret) {
            shell_print(sh, "%3d", slot_value);
        }
    } else if (argc == 3) {
        // Write slot to value
        ret = dmx_set_slot(mydmx, slot, slot_value);
    }

    if (ret) {
		shell_print(sh, "Error %d", ret);
	}

	return ret;
}

static int cmd_dmx_del(const struct shell *sh, size_t argc, char **argv)
{
	ARG_UNUSED(argc);
	ARG_UNUSED(argv);

	// shell_print(sh, "Printing DMX512 Universe");
	return dmx_destroy(&mydmx);
}

SHELL_STATIC_SUBCMD_SET_CREATE(dmx_cmds,
	SHELL_CMD(init, NULL, "Create DMX512 Universe", cmd_dmx_init),
	SHELL_CMD(print, NULL, "Print DMX512 Universe", cmd_dmx_print),
    SHELL_CMD(slot, NULL, "Set/Get a slot value", cmd_dmx_slot),
	SHELL_CMD(del, NULL, "Destroy DMX512 Universe", cmd_dmx_del),
	SHELL_SUBCMD_SET_END /* Array terminated. */
);
SHELL_CMD_REGISTER(dmx, &dmx_cmds, "DMX512 commands", NULL);
```
